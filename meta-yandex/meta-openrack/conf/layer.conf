## meta-yandex/meta-openrack/conf/layer.conf
```bitbake
# We have a conf and classes directory, add to BBPATH
BBPATH .= ":${LAYERDIR}"

BBFILE_COLLECTIONS += "openrack"
BBFILE_PATTERN_openrack = ""
```

## meta-yandex/meta-openrack/meta-cb/conf/machine/cb.conf
```bitbake
KMACHINE = "aspeed"
KERNEL_DEVICETREE = "${KMACHINE}-rmc-gb30.dtb"

DTC_FLAGS += "-@"

require conf/machine/include/ast2400.inc
require conf/machine/include/obmc-bsp-common.inc

UBOOT_MACHINE_cb = "ast_g4_phy_defconfig"
UBOOT_ENTRYPOINT = "0x40008000"
UBOOT_LOADADDRESS = "0x40008000"

FLASH_SIZE = "32768"

OBMC_MACHINE_FEATURES += "\
        obmc-phosphor-fan-mgmt \
        obmc-phosphor-chassis-mgmt \
        obmc-phosphor-sensor-mgmt \
        obmc-phosphor-flash-mgmt \
        obmc-host-ipmi \
        "

VIRTUAL-RUNTIME_skeleton_workbook = "witherspoon-config"

PREFERRED_PROVIDER_virtual/obmc-host-ipmi-hw = "btbridged"
PREFERRED_PROVIDER_virtual/obmc-chassis-mgmt = "packagegroup-op-apps"
PREFERRED_PROVIDER_virtual/obmc-fan-mgmt = "packagegroup-op-apps"
PREFERRED_PROVIDER_virtual/obmc-flash-mgmt = "packagegroup-op-apps"
PREFERRED_PROVIDER_virtual/obmc-sensor-mgmt = "packagegroup-op-apps"
PREFERRED_PROVIDER_virtual/obmc-system-mgmt = "packagegroup-op-apps"
PREFERRED_PROVIDER_virtual/obmc-inventory-data ?= "${VIRTUAL-RUNTIME_skeleton_workbook}"
```

## meta-yandex/meta-openrack/meta-shaosi/conf/bblayers.conf.sample
```bitbake
# LAYER_CONF_VERSION is increased each time build/conf/bblayers.conf
# changes incompatibly
LCONF_VERSION = "1"

BBPATH = "${TOPDIR}"
BBFILES ?= ""

BBLAYERS ?= " \
  ##OEROOT##/meta \
  ##OEROOT##/meta-poky \
  ##OEROOT##/import-layers/meta-openembedded/meta-oe \
  ##OEROOT##/import-layers/meta-openembedded/meta-networking \
  ##OEROOT##/import-layers/meta-openembedded/meta-python \
  ##OEROOT##/import-layers/meta-virtualization \
  ##OEROOT##/meta-phosphor \
  ##OEROOT##/meta-openbmc-bsp/meta-aspeed \
  ##OEROOT##/meta-openbmc-bsp/meta-aspeed/meta-ast2400 \
  ##OEROOT##/meta-openbmc-yandex/meta-yandex \
  ##OEROOT##/meta-openbmc-yandex/meta-yandex/meta-openrack \
  ##OEROOT##/meta-openbmc-yandex/meta-yandex/meta-openrack/meta-shaosi \
  "
BBLAYERS_NON_REMOVABLE ?= " \
  ##OEROOT##/meta \
  ##OEROOT##/meta-poky \
  ##OEROOT##/import-layers/meta-openembedded/meta-oe \
  ##OEROOT##/import-layers/meta-openembedded/meta-networking \
  ##OEROOT##/import-layers/meta-openembedded/meta-python \
  ##OEROOT##/import-layers/meta-virtualization \
  ##OEROOT##/meta-phosphor \
  ##OEROOT##/meta-openbmc-bsp/meta-aspeed \
  ##OEROOT##/meta-openbmc-bsp/meta-aspeed/meta-ast2400 \
  ##OEROOT##/meta-openbmc-yandex/meta-yandex \
  ##OEROOT##/meta-openbmc-yandex/meta-yandex/meta-openrack \
  ##OEROOT##/meta-openbmc-yandex/meta-yandex/meta-openrack/meta-shaosi \
  "
```

## meta-yandex/meta-openrack/meta-shaosi/conf/layer.conf
```bitbake
# We have a conf and classes directory, add to BBPATH
BBPATH .= ":${LAYERDIR}"

LAYER_DIR = "${LAYERDIR}"

# We have recipes-* directories, add to BBFILES
BBFILES += "${LAYERDIR}/recipes-*/*/*.bb \
            ${LAYERDIR}/recipes-*/*/*.bbappend"

BBFILE_COLLECTIONS += "shaosi"
BBFILE_PATTERN_shaosi = ""
```
